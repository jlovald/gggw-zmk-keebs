/*
 * Copyright (c) 2025 Vincent Franco
 * SPDX-License-Identifier: MIT
 */

#include "crosses.dtsi"

&kscan0 {
  col-gpios = <&gpio0 8 (GPIO_ACTIVE_HIGH | GPIO_PULL_DOWN)>;
  row-gpios = <&gpio0 24 GPIO_ACTIVE_HIGH>;
};

&default_transform {
  col-offset = <0>;
  row-offset = <0>;
};


