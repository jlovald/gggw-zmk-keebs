/*
 * Copyright (c) 2025 Vincent Franco
 * SPDX-License-Identifier: MIT
 */

#include "crosses.dtsi"
#include <zephyr/dt-bindings/input/input-event-codes.h>
#include <dt-bindings/zmk/input_transform.h>
#include "split_input.dtsi"
#include "pmw3360.dtsi"


&kscan0 {
  col-gpios
    = <&gpio0 8 (GPIO_ACTIVE_HIGH | GPIO_PULL_DOWN)>
		, <&gpio1 15 (GPIO_ACTIVE_HIGH | GPIO_PULL_DOWN)>
		, <&gpio1 13 (GPIO_ACTIVE_HIGH | GPIO_PULL_DOWN)>
		, <&gpio0 9 (GPIO_ACTIVE_HIGH | GPIO_PULL_DOWN)>
		, <&gpio0 10  (GPIO_ACTIVE_HIGH | GPIO_PULL_DOWN)>
		, <&gpio1 11 (GPIO_ACTIVE_HIGH | GPIO_PULL_DOWN)>
		;
};

&spi0 {
    status = "okay";
};
