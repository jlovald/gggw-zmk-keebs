## boards/shields/crosses/Kconfig.defconfig
```kconfig
# Copyright (c) 2025 Vincent Franco
# SPDX-License-Identifier: MIT

if SHIELD_CROSSES_DONGLE

config ZMK_KEYBOARD_NAME
    default "Crosses BT"

config ZMK_SPLIT_ROLE_CENTRAL
    default y

endif # SHIELD_CROSSES_DONGLE


if SHIELD_CROSSES_LEFT || SHIELD_CROSSES_RIGHT

config ZMK_SPLIT
    default y

if ZMK_DISPLAY

config I2C
    default y

config SSD1306
    default y

endif # ZMK_DISPLAY

endif # SHIELD_CROSSES_LEFT || SHIELD_CROSSES_RIGHT

if SHIELD_CROSSES_PEDALS
config ZMK_SPLIT
    default y
endif # PEDALS

if SHIELD_CROSSES_DONGLE

if ZMK_DISPLAY

config I2C
    default y

config SSD1306
    default y

choice ZMK_DISPLAY_WORK_QUEUE
    default ZMK_DISPLAY_WORK_QUEUE_DEDICATED
endchoice

if SSD1306

config LV_Z_VDB_SIZE
    default 64

config LV_DPI_DEF
    default 148

config LV_Z_BITS_PER_PIXEL
    default 1

choice LV_COLOR_DEPTH
    default LV_COLOR_DEPTH_1
endchoice

endif # SSD1306
endif # ZMK_DISPLAY
endif # SHIELD_CROSSES_DONGLE
```

## config/west.yml
```yaml
manifest:
  defaults:
    revision: v0.3
  remotes:
    - name: zmkfirmware
      url-base: https://github.com/zmkfirmware
    - name: efogdev
      url-base: https://github.com/efogdev
    - name: badjeff
      url-base: https://github.com/badjeff
    - name: caksoylar
      url-base: https://github.com/caksoylar
    - name: englmaxi
      url-base: https://github.com/englmaxi
    - name: tokyo2006
      url-base: https://github.com/tokyo2006
  projects:
    - name: zmk
      remote: zmkfirmware
      import: app/west.yml
    - name: zmk-pmw3610-driver
      remote: efogdev
      revision: zephyr-4.1
    - name: zmk-report-rate-limit
      remote: efogdev
      revision: main
    - name: zmk-input-processor-xyz
      remote: badjeff
      revision: main
    - name: zmk-rgbled-widget
      remote: caksoylar
      revision: main
    - name: prospector-zmk-module                 # <--- and these
      remote: tokyo2006                          # <---
      revision: change_spi2
    - name: zmk-dongle-display
      remote: englmaxi
      revision: v0.3
  self:
    path: config
```
